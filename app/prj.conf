## CMakeLists.txt
```
# Copyright (c) 2025 CATIE
# SPDX-License-Identifier: Apache-2.0

cmake_minimum_required(VERSION 3.13.1)
find_package(Zephyr REQUIRED HINTS $ENV{ZEPHYR_BASE})

project(nextfab_zephyr-lsm303dlhc LANGUAGES C)

target_sources(app PRIVATE src/main.c)
```

## prj.conf
```kconfig
# Copyright (c) 2025 CATIE
# SPDX-License-Identifier: Apache-2.0
```

## src/main.c
```c
/*
 * Copyright (c) 2025, CATIE
 * SPDX-License-Identifier: Apache-2.0
 */

#include <zephyr/kernel.h>

int main(void)
{
	while (1) {
		printk("Alive\n");
		k_sleep(K_MSEC(1000));
	}

	return 0;
}
```
